## mm/llfree/Kconfig
```kconfig
# SPDX-License-Identifier: GPL-2.0-only

menu "LLFree Page Allocator"

config LLFREE
	bool "LLFree Allocator"
	depends on X86_64 && SPARSEMEM && SLUB
	help
	  A new experimental allocator for volatile and persistent memory.

config LLFREE_SIZE_COUNTERS
	bool "Size counters"
	depends on X86_64 && SPARSEMEM && SLUB
	help
	  Debug counters for page allocations.

config LLFREE_FAST_FREE
	bool "Fast frees"
	depends on X86_64 && SPARSEMEM && SLUB
	help
	  Skip struct page checks for higher order frees. This might break memory hotplugging.

config LLFREE_PAGE_CACHE
	bool "Page cache gfp flag"
	help
	  Encode PAGE_CACHE in GFP for improved fragmentation avoidance.

config LLFREE_TREE_HUGE_ORDER
	int "Number of huge pages per tree"
	depends on LLFREE
	default 3
	help
      This defines the order of the huge pages in a tree.
      It is expected to be between 0 and 9 (inclusive).

endmenu
```
