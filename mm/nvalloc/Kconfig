## mm/nvalloc/Kconfig
```kconfig
# SPDX-License-Identifier: GPL-2.0-only

menu "NVAlloc Page Allocator"

config NVALLOC
	bool "NVALLOC Allocator"
	depends on X86_64 && SPARSEMEM && SLUB
	help
	  A new experimental allocator for volatile and persistent memory.

config NVALLOC_SIZE_COUNTERS
	bool "Size counters"
	depends on X86_64 && SPARSEMEM && SLUB
	help
	  Debug counters for page allocations.

endmenu
```
